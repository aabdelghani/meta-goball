## conf/distro/goball-distro.conf
```bitbake
DISTRO = "goball-distro"
DISTRO_NAME = "GoBall OS"
DISTRO_VERSION = "1.0"

DISTRO_FEATURES = "alsa pulseaudio systemd usbhost opengl wayland pam"
DISTRO_FEATURES_BACKFILL_CONSIDERED:append = " sysvinit"

VIRTUAL-RUNTIME_init_manager = "systemd"
VIRTUAL-RUNTIME_initscripts = "systemd-compat-units"

# Use standard FFmpeg 6.x instead of rpidistro-ffmpeg 4.x (mpv 0.41.0 needs libavcodec >= 60)
PREFERRED_PROVIDER_ffmpeg = "ffmpeg"
PREFERRED_PROVIDER_libav = "ffmpeg"
PREFERRED_PROVIDER_libpostproc = "ffmpeg"

# Allow FFmpeg's commercial license
LICENSE_FLAGS_ACCEPTED:append = " commercial"
```

## conf/layer.conf
```bitbake
# We have a conf and classes directory, add to BBPATH
BBPATH .= ":${LAYERDIR}"

# We have recipes-* directories, add to BBFILES
BBFILES += "${LAYERDIR}/recipes-*/*/*.bb \
            ${LAYERDIR}/recipes-*/*/*.bbappend"

BBFILE_COLLECTIONS += "meta-goball"
BBFILE_PATTERN_meta-goball = "^${LAYERDIR}/"
BBFILE_PRIORITY_meta-goball = "10"

LAYERDEPENDS_meta-goball = "core raspberrypi"
LAYERSERIES_COMPAT_meta-goball = "scarthgap"
```
